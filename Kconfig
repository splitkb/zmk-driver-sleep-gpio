## Kconfig
```kconfig
menuconfig SPLITKB_SLEEP_GPIO
    bool "Sleep GPIO support"
    default $(dt_compat_enabled,$(DT_COMPAT_SPLITKB_SLEEP_GPIO))
    depends on ZMK_SLEEP
    help
        Enable GPIO control based on ZMK sleep state
```

## dts/bindings/splitkb,sleep-gpio.yaml
```yaml
description: GPIO pin controlled by ZMK sleep state
compatible: "splitkb,sleep-gpio"

include: base.yaml

properties:
    gpios:
        type: phandle-array
        required: true
        description: The GPIO pin to control
```
